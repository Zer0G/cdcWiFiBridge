## cdcLinkClient/sdkconfig.defaults
```kconfig
CONFIG_IDF_TARGET="esp32s3"

CONFIG_ESPTOOLPY_FLASHSIZE_16MB=y
CONFIG_ESPTOOLPY_FLASHMODE_QIO=y

CONFIG_PARTITION_TABLE_CUSTOM=y

CONFIG_SPIRAM=y
CONFIG_SPIRAM_MODE_OCT=y
CONFIG_SPIRAM_SPEED_80M=y

CONFIG_LV_COLOR_16_SWAP=y
CONFIG_LV_FONT_MONTSERRAT_12=y
CONFIG_LV_FONT_MONTSERRAT_16=y
CONFIG_LV_FONT_MONTSERRAT_20=y
CONFIG_LV_USE_DEMO_WIDGETS=y
CONFIG_LV_USE_DEMO_BENCHMARK=y
CONFIG_LV_USE_DEMO_STRESS=y
CONFIG_LV_USE_DEMO_MUSIC=y

## LVGL8 ##
CONFIG_LV_MEM_SIZE_KILOBYTES=48


#
# Example Configuration
#
CONFIG_ESPNOW_WIFI_MODE_STATION=y
# CONFIG_ESPNOW_WIFI_MODE_STATION_SOFTAP is not set
CONFIG_ESPNOW_PMK="pmk1234567890123"
CONFIG_ESPNOW_LMK="lmk1234567890123"
CONFIG_ESPNOW_CHANNEL=1
CONFIG_ESPNOW_SEND_COUNT=100
CONFIG_ESPNOW_SEND_DELAY=1000
CONFIG_ESPNOW_SEND_LEN=10
# CONFIG_ESPNOW_ENABLE_LONG_RANGE is not set
# CONFIG_ESPNOW_ENABLE_POWER_SAVE is not set
# end of Example Configuration
```
